## braiins-os/package/mining/bosminer/Config.in
```kconfig
config EXTERNAL_BOSMINER_TREE
    string "Use external BOSMiner tree" if DEVEL
    default ""

config BOSMINER_SUFFIX
    string "Append suffix to bosminer path" if DEVEL
    default ""

choice
    prompt "Preferred backend for BOSMiner"
    default BOSMINER_BACKEND_antminer_s9 if TARGET_zynq_am1_s9
    help
      Select the preferred backend for BOSMiner.

    config BOSMINER_BACKEND_antminer_s9
        bool "AntMiner S9"

    config BOSMINER_BACKEND_erupter
        bool "Block Erupter"

endchoice
```

## braiins-os/package/system/bos_plus/Config.in
```kconfig
config BOS_PLUS_FEEDS_SERVER
    string "URL of feeds server with BOS+ firmware packages"
    default "https://feeds.braiins-os.com"
```

## braiins-os/package/system/firmware/Config.in
```kconfig
config FIRMWARE_MAJOR
    string "Firmware major version"
    default ""

config FIRMWARE_VERSION
    string "Firmware version"
    default ""

config FIRMWARE_REQUIRE
    string "Previous firmware version required by this firmware"
    default ""

config FIRMWARE_FEEDS_SERVER
    string "URL of feeds server with firmware packages"
    default "https://feeds.braiins-os.org"
```
